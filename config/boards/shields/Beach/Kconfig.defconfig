## config/boards/shields/Beach/Kconfig.defconfig
```kconfig
# Copyright (c) 2020 The ZMK Contributors
# SPDX-License-Identifier: MIT

if SHIELD_BEACH

config ZMK_KEYBOARD_NAME
    default "Beach"

endif
```

## config/boards/shields/Bobor/Kconfig.defconfig
```kconfig
# Copyright (c) 2020 The ZMK Contributors
# SPDX-License-Identifier: MIT

if SHIELD_BOBOR

config ZMK_KEYBOARD_NAME
    default "Bobor"

endif
```

## config/boards/shields/Bobor/Kconfig.shield
```kconfig
# Copyright (c) 2020 The ZMK Contributors
# SPDX-License-Identifier: MIT

config SHIELD_BOBOR
    def_bool $(shields_list_contains,Bobor)
```

## config/boards/shields/Coko/Kconfig.defconfig
```kconfig
# Copyright (c) 2020 The ZMK Contributors
# SPDX-License-Identifier: MIT

if SHIELD_COKO

config ZMK_KEYBOARD_NAME
    default "Coko"

endif
```

## config/boards/shields/LJ_frood/Kconfig.defconfig
```kconfig
# Copyright (c) 2021 The ZMK Contributors
# SPDX-License-Identifier: MIT

if SHIELD_LUMBERJACK_FROOD

config ZMK_KEYBOARD_NAME
    default "Lumberjack Frood"

if ZMK_RGB_UNDERGLOW

config WS2812_STRIP
    default y
endif

endif
```

## config/boards/shields/LJ_frood/Kconfig.shield
```kconfig
# Copyright (c) 2021 The ZMK Contributors
# SPDX-License-Identifier: MIT

config SHIELD_LUMBERJACK_FROOD
    def_bool $(shields_list_contains,LJ_frood)
```

## config/boards/shields/PLnvCK/Kconfig.shield
```kconfig
# Copyright (c) 2020 The ZMK Contributors
# SPDX-License-Identifier: MIT

config SHIELD_PLNVCK
    def_bool $(shields_list_contains,PLnvCK)
```

## config/west.yml
```yaml
manifest:
  defaults:
    revision: v0.1 # version to use for this module and for ZMK
  remotes:
    - name: zmkfirmware
      url-base: https://github.com/zmkfirmware
    - name: caksoylar
      url-base: https://github.com/caksoylar
    - name: xudongz
      url-base: https://github.com/xudongzheng
    - name: urob
      url-base: https://github.com/urob
    - name: zephyr35
      url-base: https://github.com/petejohanson
  projects:
    - name: zmk
#      remote: zmkfirmware
#      revision: fix-battery-reporting
#      revision: custom-wq-pr
#      revision: main
      # remote: zephyr35
      # revision: core/zephyr-3.5-update
      remote: zmkfirmware
      revision: main
      import: app/west.yml
    - name: zmk-adaptive-key
      remote: urob
  self:
    path: config
```
